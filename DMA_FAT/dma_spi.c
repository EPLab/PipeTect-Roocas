#include "dma_spi.h"
#include "msp430x54x.h"

static unsigned char DMA_SPI_enabled = 0;

void (*DMA0IFG_CB)() = 0;
void (*DMA1IFG_CB)() = 0;

//const unsigned char DummyBytesArray2[DUMMY_BYTES_LENGTH] = {0x00};
const unsigned char DummyBytesArray[DUMMY_BYTES_LENGTH]
				 = {0xFF, 0xFF, 0xFF, 0xFF, 0xFF, 0xFF, 0xFF, 0xFF, 0xFF, 0xFF, 0xFF, 0xFF, 0xFF, 0xFF, 0xFF, 0xFF,
				    0xFF, 0xFF, 0xFF, 0xFF, 0xFF, 0xFF, 0xFF, 0xFF, 0xFF, 0xFF, 0xFF, 0xFF, 0xFF, 0xFF, 0xFF, 0xFF,
					0xFF, 0xFF, 0xFF, 0xFF, 0xFF, 0xFF, 0xFF, 0xFF, 0xFF, 0xFF, 0xFF, 0xFF, 0xFF, 0xFF, 0xFF, 0xFF,
					0xFF, 0xFF, 0xFF, 0xFF, 0xFF, 0xFF, 0xFF, 0xFF, 0xFF, 0xFF, 0xFF, 0xFF, 0xFF, 0xFF, 0xFF, 0xFF,
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					0xFF, 0xFF, 0xFF, 0xFF, 0xFF, 0xFF, 0xFF, 0xFF, 0xFF, 0xFF, 0xFF, 0xFF, 0xFF, 0xFF, 0xFF, 0xFF};

void init_DMA_SPI(unsigned char db)
{
	if (!DMA_SPI_enabled)
	{
		//unsigned short i;
		//for (i = 0; i < 1024; ++i)
		//{
		//    DummyBytesArray[i] = db;
		//}
		// CS config for SD CARD
		P4SEL &= 0xFE;
		P4DIR |= 0x01;
		P4OUT |= 0x01;
		
		// CS config for FRAM
		P4SEL &= 0xFD;
		P4DIR |= 0x02;
		P4OUT |= 0x02;
		
		// spi ucb1 config
		P3SEL |= 0x80;
		P5SEL |= 0x30;
		
		UCB1CTL1 |= UCSWRST;                        // **Put state machine in reset**
		UCB1CTL0 = UCMST+UCSYNC+UCCKPL+UCMSB;       // 3-pin, 8-bit SPI master
													// Clock polarity high, MSB
		UCB1CTL1 = UCSSEL_2;                        // SMCLK
		UCB1BR0 = 0x02;                             // /2
		UCB1BR1 = 0x00;                             //
		//UCB1MCTL = 0x00;                          // No modulation
		UCB1CTL1 &= ~UCSWRST;                       // **Initialize USCI state machine**
	
		DMACTL0 = DMA0TSEL_23 + DMA1TSEL_22;        // DMA0 - UCA0TXIFG
													// DMA1 - UCA0RXIFG
	
		// Setup DMA0
		__data16_write_addr((unsigned short) &DMA0DA,(unsigned long) &UCB1TXBUF);
													// Destination single address
		DMA0SZ = 0;                                 // Block size
		DMA0CTL = DMASRCINCR_3+DMASBDB+DMALEVEL;    // inc src
		
		// Setup DMA1
		__data16_write_addr((unsigned short) &DMA1SA,(unsigned long) &UCB1RXBUF);
													// Source block address
		DMA1SZ = 0;                                 // Block size
		DMA1CTL = DMADSTINCR_3+DMASBDB+DMALEVEL;    // inc dst
		
		__bis_SR_register(/*LPM3_bits + */GIE);     // Enter LPM3 w/ interrupts
		__no_operation();                           // Required only for debugger
	
		DMA0CTL |= DMADT_2;
		DMA1CTL |= DMADT_2;
		
		// DMA interrupt for channer 1 and 2
		DMA0CTL &= (~DMAIFG);
		DMA0CTL += DMAIE;
		
		DMA1CTL &= (~DMAIFG);
		DMA1CTL += DMAIE;
		
		DMA_SPI_enabled = 1;
	}
}

unsigned char DMA_SPI_Write(unsigned char* buf, unsigned long length, void (*fp)(void))
{
    if (UCB1IFG & UCTXIFG)
    {
        DMA0IFG_CB = fp;
        DMA1IFG_CB = 0;
        // Setup DMA0
        
        __data16_write_addr((unsigned short) &DMA0SA,(unsigned long) buf);
                                                    // Source block address
        DMA0SZ = length;
        //DMA0CTL = DMADT_2+DMASRCINCR_3+DMASBDB+DMALEVEL;
 
        DMA0CTL &= (~DMAIFG);
        DMA0CTL |= DMAIE;
    	DMA1CTL &= (~DMAIFG);
        DMA1CTL &= (~DMAIE);                        // disale DMA1 interrupt
        
        DMA0CTL |= DMAEN;                           // DMA0 Enable
        return 1;
    }
    return 0;
}

unsigned char DMA_SPI_Read(unsigned char* buf, unsigned long length, void (*fp)(void))
{   
    if (UCB1IFG & UCTXIFG)
    {
        DMA0IFG_CB = 0;
        DMA1IFG_CB = fp;
        // Setup DMA0
        __data16_write_addr((unsigned short) &DMA0SA,(unsigned long) DummyBytesArray);
                                                    // Source block address
        DMA0SZ = length;                            // Block size
        //DMA0CTL = DMADT_2+DMASRCINCR_3+DMASBDB+DMALEVEL;
        
        // Setup DMA1
        __data16_write_addr((unsigned short) &DMA1DA,(unsigned long) buf);
                                                    // Destination single address
        DMA1SZ = length;                            // Block size
        //DMA1CTL = DMADT_2+DMADSTINCR_3+DMASBDB+DMALEVEL;
        
		DMA0CTL &= (~DMAIFG);
        DMA0CTL &= (~DMAIE);
        DMA1CTL &= (~DMAIFG);
        DMA1CTL |= DMAIE;
        
        DMA0CTL |= DMAEN;                         // DMA0 Enable
        DMA1CTL |= DMAEN;                         // DMA1 Enable
        return 1;
    }
    return 0;
}
            
void setDMA0IFG_CB(void (*func)(void))
{
    DMA0IFG_CB = func;
}

void setDMA1IFG_CB(void (*func)(void))
{
    DMA1IFG_CB = func;
}

void N_DMA_WriteByteSPI(unsigned char aByte)
{
    UCB1TXBUF = aByte;
    while (!(UCB1IFG & UCTXIFG));
}

void N_DMA_ReadByteSPI(unsigned char* ptr)
{
    while (!(UCB1IFG & UCRXIFG));
    *ptr = UCB1RXBUF;
}

unsigned char DMA_SPI_IsBeingUsed(void)
{
	if ((DMA0CTL & DMAEN) || (DMA1CTL & DMAEN))
	{
		return 1;
	}
	return 0;
}

#pragma vector=DMA_VECTOR
__interrupt void DMA_ISR(void)
{
    if (DMA0CTL & DMAIE)
    {
        DMA0CTL &= (~DMAIFG);
        if (DMA0IFG_CB)
        {
            DMA0IFG_CB();
        }
        //DMA0CTL &= ~DMAEN;
		return;
    }
    if (DMA1CTL & DMAIE)
    {
        DMA1CTL &= (~DMAIFG);
        if (DMA1IFG_CB)
        {
            DMA1IFG_CB();
        }
        //DMA1CTL &= ~DMAEN;                         // DMA1 Enable
    }
}
